## config/boards/shields/yoshi_mas/Kconfig.defconfig
```kconfig
if SHIELD_yoshi_mas_LEFT

config ZMK_KEYBOARD_NAME
        default "yoshio_masterv1"

config ZMK_SPLIT_ROLE_CENTRAL
        default y

endif

if SHIELD_yoshi_mas_LEFT || SHIELD_yoshi_mas_RIGHT

config ZMK_SPLIT
        default y

endif
```

## config/boards/shields/yoshi_mas/Kconfig.shield
```kconfig
config SHIELD_yoshi_mas_LEFT
        def_bool $(shields_list_contains,yoshi_mas_left)

config SHIELD_yoshi_mas_RIGHT
        def_bool $(shields_list_contains,yoshi_mas_right)
```
